## CMakeLists.txt
```
# SPDX-License-Identifier: Apache-2.0

cmake_minimum_required(VERSION 3.20.0)

find_package(Zephyr REQUIRED HINTS $ENV{ZEPHYR_BASE})
project(synchronization-sched)



set(CMAKE_C_FLAGS "-O0 -Wall -Wextra")
set(CMAKE_C_FLAGS_DEBUG "-g -O0 -Wall -Wextra")
set(CMAKE_CXX_FLAGS "-O0 -Wall -Wextra")
set(CMAKE_CXX_FLAGS_DEBUG "-g -O0 -Wall -Wextra")

target_sources(app PRIVATE src/main.c)
```

## prj.conf
```kconfig
CONFIG_STDOUT_CONSOLE=y
CONFIG_SYS_CLOCK_TICKS_PER_SEC=100000
CONFIG_TIMESLICE_SIZE=3000
CONFIG_SCHED_SIM_PFAIR=y
CONFIG_SCHED_SIM_PFAIR_LAG=0
CONFIG_SCHED_SIM_PFAIR_P1=2147483648
CONFIG_SCHED_DUMB=n
CONFIG_BOOT_BANNER=n
# enable to use thread names
CONFIG_THREAD_NAME=y
CONFIG_SCHED_CPU_MASK=y
CONFIG_SCHED_DEADLINE=n
#CONFIG_{NO,DEBUG,SPEED,SIZE}_OPTIMIZATIONS
CONFIG_NO_OPTIMIZATIONS=y
CONFIG_SOC_SERIES_PROVIDE_HW_CONTEXT_STACK=n
CONFIG_SOC_SERIES_PROVIDE_HW_CONTEXT_UNSTACK=n
CONFIG_SOC_SERIES_CVA6_PROVIDE_TEST_POWEROFF=n
CONFIG_SOC_SERIES_CVA6_PROVIDE_FPGA_POWEROFF=y
CONFIG_TRACING=y
CONFIG_PERCEPIO_TRACERECORDER=y
CONFIG_PERCEPIO_TRC_START_MODE_START=y
CONFIG_PERCEPIO_TRC_CFG_STREAM_PORT_RINGBUFFER=y
CONFIG_PERCEPIO_TRC_CFG_STREAM_PORT_RINGBUFFER_SIZE=40960
CONFIG_PERCEPIO_TRC_CFG_CTRL_TASK_PRIORITY=6
#CONFIG_PERCEPIO_TRC_CFG_CTRL_TASK_DELAY=2500
```

## src/main.c
```c
#include <zephyr/kernel.h>
#include <zephyr/sys/printk.h>
#include <zephyr/sys/poweroff.h>

/* Definizione delle dimensioni dello stack per i thread */
#define STACK_SIZE 2048

/* Definizione delle priorità dei thread (valore minore = maggiore priorità) */
#define THREAD1_PRIORITY 5
#define THREAD2_PRIORITY 5
#define NUM_LOOP 10

/* Definizione delle strutture dati per i thread */
K_THREAD_STACK_DEFINE(thread1_stack, STACK_SIZE);
K_THREAD_STACK_DEFINE(thread2_stack, STACK_SIZE);
struct k_thread thread1_data;
struct k_thread thread2_data;
int end_loop = 1, end_t = 1;
uint64_t mret_start,mret_end;
volatile int id_thread = -1;

void my_timer_handler(struct k_timer *dummy)
{
	printf("interrupt\n");
	end_loop = 0;
	ARG_UNUSED(dummy);
}


K_TIMER_DEFINE(my_timer, my_timer_handler, NULL);


void thread1(void *arg1, void *arg2, void *arg3) {
	k_yield();
	ARG_UNUSED(arg1);
	ARG_UNUSED(arg2);
	ARG_UNUSED(arg3);
	do{
		if(id_thread != 1){
			id_thread = 1;
			printf("thread 1\n");
		}
	}while(end_loop);
}

void thread2(void *arg1, void *arg2, void *arg3) {
	k_yield();
	ARG_UNUSED(arg1);
	ARG_UNUSED(arg2);
	ARG_UNUSED(arg3);
	do{
		if(id_thread != 2){
			id_thread = 2;
			printf("thread 2\n");
		}
	}while(end_loop);
}

static inline uint64_t read_mret(void) {
    uint64_t v3;
    __asm__ volatile ("csrr %0, mhpmcounter3" : "=r"(v3));
    return v3;
}

static inline void enable_pmc(void) {
    uint64_t val;
    __asm__ volatile ("csrrc %0, mcountinhibit, %1" : "=r"(val) : "r"(1 << 3));
}

int main(void) {
	/*enable_pmc();
	__asm__ volatile ("csrw mhpmevent3, 28");*/
	k_sleep(K_MSEC(1));
	printf("start main\n");
    k_tid_t t1 = k_thread_create(&thread1_data, thread1_stack, STACK_SIZE,
                                   thread1, NULL, NULL, NULL,
                                   THREAD1_PRIORITY, 0, K_NO_WAIT);
	k_thread_name_set(t1,"T1");							   
	k_tid_t t2 = k_thread_create(&thread2_data,thread2_stack,STACK_SIZE,thread2,NULL,NULL,NULL,
									THREAD2_PRIORITY,0,K_NO_WAIT);							   
	
	k_thread_name_set(t2, "T2");
	k_timer_start(&my_timer, K_MSEC(60000), K_NO_WAIT);
	k_thread_join(t1,K_FOREVER);
	k_thread_join(t2,K_FOREVER);
	z_sys_poweroff();

}
```
